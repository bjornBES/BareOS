OUTPUT_FORMAT("elf64-x86-64")
OUTPUT_ARCH(i386:x86-64)
KERNEL_VMA = 0xFFFFFFFF80000000;
KERNEL_LMA = 0x0000000000200000;
HEAP_SIZE = 0;
FRAME_BITMAP_SIZE = 0;
EARLY_HEAP_SIZE = 0x50000;

INCLUDE "linker.ld"
